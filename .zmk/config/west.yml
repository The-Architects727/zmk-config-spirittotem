## Kconfig
```kconfig
# Copyright (c) 2026
# SPDX-License-Identifier: MIT

config TOTEM_BATTERY_LED
    bool "Low-battery LEDs on the Totem dongle for each split half"
    default y
    depends on ZMK_SPLIT_ROLE_CENTRAL
    depends on ZMK_SPLIT_BLE_CENTRAL_BATTERY_LEVEL_FETCHING

config TOTEM_SLEEP_WARN
    bool "Flash the onboard LED before sleeping, and auto-sleep when the central is unreachable"
    default y
    depends on ZMK_SPLIT && !ZMK_SPLIT_ROLE_CENTRAL
    depends on ZMK_PM_SOFT_OFF
```

## dts/bindings/behaviors/zmk,behavior-battery-check.yaml
```yaml
description: Blink the dongle's battery LEDs to report each split half's charge in 10% steps

compatible: "zmk,behavior-battery-check"

include: zero_param.yaml
```

## dts/bindings/behaviors/zmk,behavior-totem-sleep.yaml
```yaml
description: Flashes the onboard LED a few times, then puts this half to sleep via soft-off

compatible: "zmk,behavior-totem-sleep"

include: zero_param.yaml
```
